## sophgo/image/multi.its
```
/*
 * U-Boot uImage source file with multiple kernels, ramdisks and FDT blobs
 */

/dts-v1/;

/ {
	description = "Various kernels, ramdisks and FDT blobs";
	#address-cells = <2>;

	images {
		kernel-1 {
			description = "cvitek kernel";
			data = /incbin/("${images_dir}/Image.lzma");
			type = "kernel";
			arch = "arm64";
			os = "linux";
			compression = "lzma";
			load = <0x0 0x80200000>;
			entry = <0x0 0x80200000>;
			hash-2 {
				algo = "crc32";
			};
		};

		/*FDT*/
    
        fdt-1 {
            description = "cvitek device tree - sg2000_milkv_duos_glibc_arm64_sd";
            data = /incbin/("./cv1813h_milkv_duos_arm_sd.dtb");
            type = "flat_dt";
            arch = "arm64";
            compression = "none";
            hash-1 {
                algo = "sha256";
            };
        };

	};

	/*CFG*/
    configurations {
        
        config-cv18xx-openwrt {
            description = "boot cvitek system with board sg2000_milkv_duos_glibc_arm64_sd";
            kernel = "kernel-1";
            fdt = "fdt-1";
        };
    };
};
```
